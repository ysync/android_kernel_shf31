/* Copyright (c) 2013, The Linux Foundation. All rights reserved.
 *
 * This program is free software; you can redistribute it and/or modify
 * it under the terms of the GNU General Public License version 2 and
 * only version 2 as published by the Free Software Foundation.
 *
 * This program is distributed in the hope that it will be useful,
 * but WITHOUT ANY WARRANTY; without even the implied warranty of
 * MERCHANTABILITY or FITNESS FOR A PARTICULAR PURPOSE.  See the
 * GNU General Public License for more details.
 */


/dts-v1/;
/include/ "msm8926.dtsi"
/include/ "sharp-common.dtsi"
/include/ "sharp-kf10-720p.dtsi"

/ {
	model = "sharp kf10";
	compatible = "qcom,sharp-kf10", "qcom,msm8926-cdp", "qcom,msm8926", "qcom,cdp";
	qcom,board-id = <68 0>;
};

&pm8226_chg {
	status = "ok";
};

&hsic_host {
	status = "ok";
};
