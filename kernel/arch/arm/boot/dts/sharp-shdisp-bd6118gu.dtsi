/* Copyright (c) 2014, The Linux Foundation. All rights reserved.
 *
 * This program is free software; you can redistribute it and/or modify
 * it under the terms of the GNU General Public License version 2 and
 * only version 2 as published by the Free Software Foundation.
 *
 * This program is distributed in the hope that it will be useful,
 * but WITHOUT ANY WARRANTY; without even the implied warranty of
 * MERCHANTABILITY or FITNESS FOR A PARTICULAR PURPOSE.  See the
 * GNU General Public License for more details.
 */

&soc {
	/*---------------------*/
	/* backlight IC        */
	/*---------------------*/
	sharp,shdisp_bd6118gu {
		compatible = "sharp,shdisp_bdic";
		status = "disable";
		interrupts = <31 0>;
		interrupt-parent = <&msmgpio>;
		vddio-supply = <&pm8226_l6>;
	};

	i2c@f9923000 {
		bdic_i2c@76 {
			compatible = "sharp,bdic_i2c";
			status = "ok";
			reg = <0x76>;
		};
	};

};
