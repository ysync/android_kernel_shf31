## kernel/drivers/sharp/Kconfig
```kconfig
#
# SHARP configuration
#

menu "SHARP Device Drivers"

source "drivers/sharp/shdiag/Kconfig"
source "drivers/sharp/shbatt/Kconfig"
source "drivers/sharp/mfc/Kconfig"
#CONFIG_SH_AUDIO_DRIVER-> 08-007
source "drivers/sharp/shaudio/Kconfig"
#CONFIG_SH_AUDIO_DRIVER<- 08-007
source "drivers/sharp/shtimer/Kconfig"
source "drivers/sharp/shlog/Kconfig"
source "drivers/sharp/shcamled/Kconfig"
source "drivers/sharp/shtps/Kconfig"
source "drivers/sharp/shmds/Kconfig"
source "drivers/sharp/proximity/Kconfig"
source "drivers/sharp/vold/Kconfig"
source "drivers/sharp/tunerdrv/Kconfig"

source "drivers/sharp/shterm/Kconfig"
#Modify SHARP_EXTEND SP_SBM_LC "Static link mod" 2014.02.25 Start
source "drivers/sharp/wifi/Kconfig"
#Modify SHARP_EXTEND SP_SBM_LC "Static link mod" 2014.02.25 End
source "drivers/sharp/shirda/Kconfig"
source "drivers/sharp/shkeyled/Kconfig"
source "drivers/sharp/shflip/Kconfig"
source "drivers/sharp/shtrpd/Kconfig"
source "drivers/sharp/shswic/Kconfig"
endmenu
```

## kernel/drivers/sharp/shflip/Kconfig
```kconfig
# drivers/sharp/shkeyled/Kconfig

menu "SHARP FLIP Device Drivers"

config FLIP_SWITCH
	bool "SHARP FLIP Device Drivers"
	default n

endmenu
```

## kernel/drivers/sharp/shmds/Kconfig
```kconfig
menuconfig SHMDS
	bool "Motion Sensor Drivers"
	default y

if SHMDS
source "drivers/sharp/shmds/motionsensor/Kconfig"
source "drivers/sharp/shmds/mpu6515/Kconfig"
source "drivers/sharp/shmds/mpu6515/inv_test/Kconfig"

endif
```

## kernel/drivers/sharp/shtps/sy3000/Kconfig
```kconfig
#
# Sharp Touchscreen configuration
#

if TOUCHSCREEN_SHTPS

	config SHTPS_SY3X00_DEV
		tristate "SY3x00 Device"
		default n
		depends on TOUCHSCREEN_SHTPS

	config SHTPS_SY3000_TM2949_001
		tristate "SY3000 TM2949-001"
		default n
		depends on SHTPS_SY3X00_DEV

	config SHTPS_SY3000_TM3054_001
		tristate "SY3000 TM3054-001"
		default n
		depends on SHTPS_SY3X00_DEV

endif # TOUCHSCREEN_SHTPS
```
